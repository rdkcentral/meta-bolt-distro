## meta-bolt-app-examples/conf/layer.conf
```bitbake
BBPATH .= ":${LAYERDIR}"

BBFILES += "${LAYERDIR}/recipes-*/*/*.bb \
            ${LAYERDIR}/recipes-*/*/*.bbappend"

BBFILE_COLLECTIONS += "meta-bolt-wayland-egl"
BBFILE_PATTERN_meta-bolt-wayland-egl = "^${LAYERDIR}/"
BBFILE_PRIORITY_meta-bolt-wayland-egl = "10"

LAYERDEPENDS_meta-bolt-wayland-egl = "bolt-base"
```

## meta-bolt-tools/conf/layer.conf
```bitbake
BBPATH .= ":${LAYERDIR}"

BBFILES += "${LAYERDIR}/recipes-*/*/*.bb \
            ${LAYERDIR}/recipes-*/*/*.bbappend"

BBFILE_COLLECTIONS += "bolt-tools"
BBFILE_PATTERN_bolt-tools = "^${LAYERDIR}/"
BBFILE_PRIORITY_bolt-tools = "6"

LAYERDEPENDS_bolt-tools = "bolt"
LAYERSERIES_COMPAT_bolt-tools = "kirkstone"
```
