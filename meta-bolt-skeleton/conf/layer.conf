## meta-bolt-skeleton/conf/layer.conf
```bitbake
BBPATH .= ":${LAYERDIR}"

BBFILES += "${LAYERDIR}/recipes-*/*/*.bb \
            ${LAYERDIR}/recipes-*/*/*.bbappend"

BBFILE_COLLECTIONS += "meta-bolt-skeleton"
BBFILE_PATTERN_meta-bolt-skeleton = "^${LAYERDIR}/"
BBFILE_PRIORITY_meta-bolt-skeleton = "10"

LAYERDEPENDS_meta-bolt-skeleton = "bolt-base"
LAYERSERIES_COMPAT_meta-bolt-skeleton = "kirkstone"
```
